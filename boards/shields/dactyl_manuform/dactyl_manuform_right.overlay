// iris_right.overlay

#include "dactyl_manuform.dtsi"

&default_transform { // The matrix transform for this board is 6 columns over because the left half is 6 columns wide according to the matrix.
    col-offset = <7>;
};

&kscan0 {
    row-gpios
        = <&pro_micro 6 GPIO_ACTIVE_HIGH> // row1 in the schematic
        , <&pro_micro 5 GPIO_ACTIVE_HIGH> // col2 in the schematic
        , <&pro_micro 4 GPIO_ACTIVE_HIGH> // col3 in the schematic
        , <&pro_micro 3 GPIO_ACTIVE_HIGH> // col4 in the schematic
        ;
};