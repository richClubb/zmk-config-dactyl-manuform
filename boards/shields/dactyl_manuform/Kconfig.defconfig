## boards/shields/dactyl_manuform/Kconfig.defconfig
```kconfig
if SHIELD_DACTYL_MANUFORM_LEFT

# Name must be less than 16 characters long!
config ZMK_KEYBOARD_NAME
    default "Dactyl Manuform"

config ZMK_SPLIT_ROLE_CENTRAL
    default y

endif

if SHIELD_DACTYL_MANUFORM_LEFT || SHIELD_DACTYL_MANUFORM_RIGHT

config ZMK_SPLIT
    default y

endif
```

## boards/shields/dactyl_manuform/Kconfig.shield
```kconfig
# No whitespace after the comma or in your part name!
config SHIELD_DACTYL_MANUFORM_LEFT
    def_bool $(shields_list_contains,dactyl_manuform_left)

# No whitespace after the comma or in your part name!
config SHIELD_DACTYL_MANUFORM_RIGHT
    def_bool $(shields_list_contains,dactyl_manuform_right)
```
