// dactyl_manuform_left.overlay

#include "dactyl_manuform.dtsi" // Notice that the main dtsi files are included in the overlay.

&kscan0 {
    row-gpios
        = <&pro_micro 6 GPIO_ACTIVE_HIGH> // row1 in the schematic
        , <&pro_micro 5 GPIO_ACTIVE_HIGH> // col2 in the schematic
        , <&pro_micro 4 GPIO_ACTIVE_HIGH> // col3 in the schematic
        , <&pro_micro 3 GPIO_ACTIVE_HIGH> // col4 in the schematic
        ;
};